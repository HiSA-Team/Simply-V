/* Auto-generated with create_linkerscript_fragments.py */

/* Memory blocks */
MEMORY
{
	BRAM (xrw): ORIGIN = 0x0000000000000000, LENGTH = 0x10000
	DDR2 (xrw): ORIGIN = 0x0000000080000000, LENGTH = 0x8000000
}